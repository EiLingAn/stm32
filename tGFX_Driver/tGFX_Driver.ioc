# file: tGFX_Driver.ioc
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Mcu.Family=STM32F1
Mcu.Name=STM32F103C(8-B)Tx
Mcu.Package=LQFP48
NVIC.PriorityGroup=NVIC_PRIORITYGROUP_4
PD0-OSC_IN.Mode=HSE-External-Oscillator
PD0-OSC_IN.Signal=RCC_OSC_IN
PD1-OSC_OUT.Mode=HSE-External-Oscillator
PD1-OSC_OUT.Signal=RCC_OSC_OUT
ProjectManager.HeapSize=0x200
ProjectManager.StackSize=0x400
ProjectManager.TargetToolchain=STM32CubeIDE
RCC.APB1Freq_Value=8000000
RCC.APB2Freq_Value=8000000
VP_SYS_VS_ND.Mode=No_Debug
board=custom

// file: Core/Src/main.c
/* USER CODE BEGIN Header */
/**
  ******************************************************************************
  * @file           : main.c
  * @brief          : Main program body
  ******************************************************************************
  * @attention
  *
  * Copyright (c) 2024 STMicroelectronics.
  * All rights reserved.
  *
  * This software is licensed under terms that can be found in the LICENSE file
  * in the root directory of this software component.
  * If no LICENSE file comes with this software, it is provided AS-IS.
  *
  ******************************************************************************
  */
/* USER CODE END Header */
#include "main.h"

/* USER CODE BEGIN Includes */
#include "inc/tGFX.h"
#include "inc/basic.h"

#include "inc/fonts/5x8.h"
#include "inc/font.h"

#include <stdio.h>

/* USER CODE END Includes */

void SystemClock_Config(void);
static void MX_GPIO_Init(void);

int main(void)
{

  /* MCU Configuration--------------------------------------------------------*/

  /* Reset of all peripherals, Initializes the Flash interface and the Systick. */
  HAL_Init();

  /* Configure the system clock */
  SystemClock_Config();

  /* Initialize all configured peripherals */
  MX_GPIO_Init();
  /* USER CODE BEGIN 2 */
  // use 565 color canvas.
  tGFX_Canvas *canvas = tGFX_create_canvas(256, 128, tGFX_COLOR_MODE565);
  tGFX_draw_pixel(canvas, 63, 63, 0xffff);
  tGFX_draw_line(canvas, 10, 10, 100, 30, 0x35d3);
  tGFX_draw_rect(canvas, 90, 16, 30, 20, 0xff20);
  tGFX_fill_rect(canvas, 75, 70, 30, 20, 0xff20);
  tGFX_draw_rect_radius(canvas, 12, 12, 68, 28, 14, 0xa25b);
  tGFX_draw_circle(canvas, 30, 50, 5, 0xb1a8);
  tGFX_draw_arc_quarter(canvas, 90, 80, 30, 0x05, 0xfc00);
  tGFX_draw_arc_quarter(canvas, 90, 80, 30, 0x0a, 0x03bf);
  tGFX_draw_ellipse(canvas, 30, 60, 20, 10, 0x6512);
  tGFX_draw_ellipse(canvas, 30, 60, 10, 20, 0x6512);
  uint16_t triangle[] = {10, 80, 20, 90, 0, 90};
  tGFX_draw_polygon(canvas, triangle, 3, 0xf802);
  uint16_t arrow[] = {40, 90, 50, 105, 40, 100, 30, 105};
  tGFX_draw_polygon(canvas, arrow, 4, 0x05ca);
  tGFX_draw_char(canvas, 0, 0, 'A', &FONT_5X8, 0xffff);
  uint8_t vertical_bitmap[] = {0xFE, 0x04, 0x18, 0x04, 0xFE}; // W
  tGFX_draw_bitmap_v(canvas, 10, 100, 5, 8, vertical_bitmap, 0xffff);
  tGFX_draw_bitmap(canvas, 18, 100, 8, 5, vertical_bitmap, 0xffff);
  tGFX_draw_text(canvas, 162, 84, "Hello tGFX!\n    ...", 20, &FONT_5X8, 0xffff);

  /* USER CODE END 2 */

  /* Infinite loop */
  while (1) {

  }
}

void SystemClock_Config(void)
{
  RCC_OscInitTypeDef RCC_OscInitStruct = {0};
  RCC_ClkInitTypeDef RCC_ClkInitStruct = {0};

  /** Initializes the RCC Oscillators according to the specified parameters
  * in the RCC_OscInitTypeDef structure.
  */
  RCC_OscInitStruct.OscillatorType = RCC_OSCILLATORTYPE_HSI;
  RCC_OscInitStruct.HSIState = RCC_HSI_ON;
  RCC_OscInitStruct.HSICalibrationValue = RCC_HSICALIBRATION_DEFAULT;
  RCC_OscInitStruct.PLL.PLLState = RCC_PLL_NONE;
  if (HAL_RCC_OscConfig(&RCC_OscInitStruct) != HAL_OK)
  {
    Error_Handler();
  }

  /** Initializes the CPU, AHB and APB buses clocks
  */
  RCC_ClkInitStruct.ClockType = RCC_CLOCKTYPE_HCLK|RCC_CLOCKTYPE_SYSCLK
                              |RCC_CLOCKTYPE_PCLK1|RCC_CLOCKTYPE_PCLK2;
  RCC_ClkInitStruct.SYSCLKSource = RCC_SYSCLKSOURCE_HSI;
  RCC_ClkInitStruct.AHBCLKDivider = RCC_SYSCLK_DIV1;
  RCC_ClkInitStruct.APB1CLKDivider = RCC_HCLK_DIV1;
  RCC_ClkInitStruct.APB2CLKDivider = RCC_HCLK_DIV1;

  if (HAL_RCC_ClockConfig(&RCC_ClkInitStruct, FLASH_LATENCY_0) != HAL_OK)
  {
    Error_Handler();
  }
}

static void MX_GPIO_Init(void)
{

  /* GPIO Ports Clock Enable */
  __HAL_RCC_GPIOD_CLK_ENABLE();

}

void Error_Handler(void)
{
  __disable_irq();
  while (1)
  {
  }
}
